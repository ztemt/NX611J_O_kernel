/* Copyright (c) 2013, The Linux Foundation. All rights reserved.
 *
 * This program is free software; you can redistribute it and/or modify
 * it under the terms of the GNU General Public License version 2 and
 * only version 2 as published by the Free Software Foundation.
 *
 * This program is distributed in the hope that it will be useful,
 * but WITHOUT ANY WARRANTY; without even the implied warranty of
 * MERCHANTABILITY or FITNESS FOR A PARTICULAR PURPOSE.  See the
 * GNU General Public License for more details.
 */

/*---------------------------------------------------------------------------
 * This file is autogenerated file using gcdb parser. Please do not edit it.
 * Update input XML file to add a new entry or update variable in this file
 * VERSION = "1.0"
 *---------------------------------------------------------------------------*/
&mdss_mdp {
	boe_nt36672_1080_2160_5p99_video: qcom,mdss_dsi_boe_nt36672_1080_2160_5p99_video {
		qcom,mdss-dsi-panel-name = "boe nt36672 1080 2160 5p99 video dsi panel";
		qcom,mdss-dsi-panel-controller = <&mdss_dsi0>;
		qcom,mdss-dsi-panel-type = "dsi_video_mode";
		qcom,mdss-dsi-panel-destination = "display_1";
		qcom,mdss-dsi-panel-framerate = <60>;
		qcom,mdss-dsi-virtual-channel-id = <0>;
		qcom,mdss-dsi-stream = <0>;
		qcom,mdss-dsi-panel-width = <1080>;
		qcom,mdss-dsi-panel-height = <2160>;
		qcom,mdss-dsi-h-front-porch = <100>;
		qcom,mdss-dsi-h-back-porch = <52>;
		qcom,mdss-dsi-h-pulse-width = <50>;
		qcom,mdss-dsi-h-sync-skew = <0>;
		qcom,mdss-dsi-v-front-porch = <16>;
		qcom,mdss-dsi-v-back-porch = <8>;
		qcom,mdss-dsi-v-pulse-width = <8>;
		qcom,mdss-dsi-h-left-border = <0>;
		qcom,mdss-dsi-h-right-border = <0>;
		qcom,mdss-dsi-v-top-border = <0>;
		qcom,mdss-dsi-v-bottom-border = <0>;
		qcom,mdss-dsi-bpp = <24>;
		qcom,mdss-dsi-color-order = "rgb_swap_rgb";
		qcom,mdss-dsi-underflow-color = <0xff>;
		qcom,mdss-dsi-border-color = <0>;
		qcom,mdss-dsi-on-command = [

			15 01 00 00 00 00 02 FF 20
			15 01 00 00 00 00 02 FB 01
			15 01 00 00 00 00 02 01 33
			15 01 00 00 00 00 02 06 94
			15 01 00 00 00 00 02 07 9E
			15 01 00 00 00 00 02 0E 2B
			15 01 00 00 00 00 02 0F 2E
			15 01 00 00 00 00 02 1D 33
			15 01 00 00 00 00 02 2B 21
			15 01 00 00 00 00 02 57 04
			15 01 00 00 00 00 02 68 03
			15 01 00 00 00 00 02 69 99
			15 01 00 00 00 00 02 6D 66
			15 01 00 00 00 00 02 78 00
			15 01 00 00 00 00 02 88 FE
			15 01 00 00 00 00 02 89 1D
			15 01 00 00 00 00 02 95 AF
			15 01 00 00 00 00 02 96 AF

			15 01 00 00 00 00 02 FF 24
			15 01 00 00 00 00 02 FB 01
			15 01 00 00 00 00 02 00 00
			15 01 00 00 00 00 02 01 00
			15 01 00 00 00 00 02 02 22
			15 01 00 00 00 00 02 03 0F
			15 01 00 00 00 00 02 04 0F
			15 01 00 00 00 00 02 05 03
			15 01 00 00 00 00 02 06 04
			15 01 00 00 00 00 02 07 1C
			15 01 00 00 00 00 02 08 0B
			15 01 00 00 00 00 02 09 22
			15 01 00 00 00 00 02 0A 01
			15 01 00 00 00 00 02 0B 11
			15 01 00 00 00 00 02 0C 13
			15 01 00 00 00 00 02 0D 15
			15 01 00 00 00 00 02 0E 17
			15 01 00 00 00 00 02 0F 11
			15 01 00 00 00 00 02 10 00
			15 01 00 00 00 00 02 11 00
			15 01 00 00 00 00 02 12 00
			15 01 00 00 00 00 02 13 00
			15 01 00 00 00 00 02 14 22
			15 01 00 00 00 00 02 15 0F
			15 01 00 00 00 00 02 16 0F
			15 01 00 00 00 00 02 17 03
			15 01 00 00 00 00 02 18 04
			15 01 00 00 00 00 02 19 1C

			15 01 00 00 00 00 02 1A 0B
			15 01 00 00 00 00 02 1B 22
			15 01 00 00 00 00 02 1C 01
			15 01 00 00 00 00 02 1D 11
			15 01 00 00 00 00 02 1E 13
			15 01 00 00 00 00 02 1F 15
			15 01 00 00 00 00 02 20 17
			15 01 00 00 00 00 02 21 11
			15 01 00 00 00 00 02 22 00
			15 01 00 00 00 00 02 23 00
			15 01 00 00 00 00 02 2F 02
			15 01 00 00 00 00 02 30 03
			15 01 00 00 00 00 02 31 02
			15 01 00 00 00 00 02 32 03
			15 01 00 00 00 00 02 33 0A
			15 01 00 00 00 00 02 34 05
			15 01 00 00 00 00 02 35 49
			15 01 00 00 00 00 02 37 02
			15 01 00 00 00 00 02 38 70
			15 01 00 00 00 00 02 39 70
			15 01 00 00 00 00 02 3B 40
			15 01 00 00 00 00 02 3D 20
			15 01 00 00 00 00 02 3F 70
			15 01 00 00 00 00 02 40 02
			15 01 00 00 00 00 02 60 10
			15 01 00 00 00 00 02 61 00
			15 01 00 00 00 00 02 68 C2
			15 01 00 00 00 00 02 72 1F
			15 01 00 00 00 00 02 73 1F
			15 01 00 00 00 00 02 74 1F
			15 01 00 00 00 00 02 75 1F
			15 01 00 00 00 00 02 78 80
			15 01 00 00 00 00 02 79 00
			15 01 00 00 00 00 02 7A 04
			15 01 00 00 00 00 02 7B A1
			15 01 00 00 00 00 02 7D 03
			15 01 00 00 00 00 02 7E 00
			15 01 00 00 00 00 02 80 42
			15 01 00 00 00 00 02 81 03
			15 01 00 00 00 00 02 8E F0
			15 01 00 00 00 00 02 90 00
			15 01 00 00 00 00 02 92 74
			15 01 00 00 00 00 02 93 0C
			15 01 00 00 00 00 02 94 2E
			15 01 00 00 00 00 02 9D 30
			15 01 00 00 00 00 02 B3 00
			15 01 00 00 00 00 02 B4 00
			15 01 00 00 00 00 02 B5 04
			15 01 00 00 00 00 02 DC 09
			15 01 00 00 00 00 02 DD 02
			15 01 00 00 00 00 02 DE 01
			15 01 00 00 00 00 02 DF 00
			15 01 00 00 00 00 02 E0 73
			15 01 00 00 00 00 02 E1 2A
			15 01 00 00 00 00 02 E2 09
			15 01 00 00 00 00 02 E3 00
			15 01 00 00 00 00 02 E4 00
			15 01 00 00 00 00 02 E5 00
			15 01 00 00 00 00 02 E9 04
			15 01 00 00 00 00 02 ED 40

			15 01 00 00 00 00 02 FF 25
			15 01 00 00 00 00 02 FB 01
			15 01 00 00 00 00 02 0A 81
			15 01 00 00 00 00 02 0B CD
			15 01 00 00 00 00 02 0C 01
			15 01 00 00 00 00 02 17 82
			15 01 00 00 00 00 02 19 0E
			15 01 00 00 00 00 02 21 21
			15 01 00 00 00 00 02 22 21
			15 01 00 00 00 00 02 24 74
			15 01 00 00 00 00 02 25 74
			15 01 00 00 00 00 02 30 5B
			15 01 00 00 00 00 02 40 30
			15 01 00 00 00 00 02 65 00
			15 01 00 00 00 00 02 66 DD
			15 01 00 00 00 00 02 67 01
			15 01 00 00 00 00 02 69 10
			15 01 00 00 00 00 02 6B 00
			15 01 00 00 00 00 02 6C 1D
			15 01 00 00 00 00 02 71 15
			15 01 00 00 00 00 02 7E 15
			15 01 00 00 00 00 02 7F 00
			15 01 00 00 00 00 02 80 00
			15 01 00 00 00 00 02 84 68
			15 01 00 00 00 00 02 86 70
			15 01 00 00 00 00 02 8D 00
			15 01 00 00 00 00 02 8F 04
			15 01 00 00 00 00 02 90 00
			15 01 00 00 00 00 02 C1 1A
			15 01 00 00 00 00 02 C3 00
			15 01 00 00 00 00 02 D7 00
			15 01 00 00 00 00 02 D8 05
			15 01 00 00 00 00 02 D9 00
			15 01 00 00 00 00 02 DA 00
			15 01 00 00 00 00 02 DB 05
			15 01 00 00 00 00 02 DC 00

			15 01 00 00 00 00 02 FF 26
			15 01 00 00 00 00 02 FB 01
			15 01 00 00 00 00 02 02 01
			15 01 00 00 00 00 02 04 26
			15 01 00 00 00 00 02 06 C8
			15 01 00 00 00 00 02 12 5A
			15 01 00 00 00 00 02 19 09
			15 01 00 00 00 00 02 1A 84
			15 01 00 00 00 00 02 1C FA
			15 01 00 00 00 00 02 1D 09
			15 01 00 00 00 00 02 1E 0B
			15 01 00 00 00 00 02 36 AF
			15 01 00 00 00 00 02 37 1D
			15 01 00 00 00 00 02 38 FE
			15 01 00 00 00 00 02 4F AF
			15 01 00 00 00 00 02 68 AF
			15 01 00 00 00 00 02 99 20
			15 01 00 00 00 00 02 FF 27
			15 01 00 00 00 00 02 FB 01
			15 01 00 00 00 00 02 13 08
			15 01 00 00 00 00 02 14 43
			15 01 00 00 00 00 02 16 B8
			15 01 00 00 00 00 02 17 B8
			15 01 00 00 00 00 02 B3 01
			15 01 00 00 00 00 02 B5 58
			15 01 00 00 00 00 02 FF 10

			05 01 00 00 64 00 01 11

			05 01 00 00 2d 00 01 29

			15 01 00 00 00 00 02 51 ff
			];
		qcom,mdss-dsi-off-command = [
			05 01 00 00 64 00 01 28
			05 01 00 00 55 00 01 10];
		qcom,mdss-dsi-on-command-state = "dsi_lp_mode";
		qcom,mdss-dsi-off-command-state = "dsi_hs_mode";
		qcom,mdss-dsi-h-sync-pulse = <0>;
		qcom,mdss-dsi-traffic-mode = "burst_mode";
		qcom,mdss-dsi-lane-map = "lane_map_0123";
		qcom,mdss-dsi-bllp-eof-power-mode;
		qcom,mdss-dsi-bllp-power-mode;
		qcom,mdss-dsi-lane-0-state;
		qcom,mdss-dsi-lane-1-state;
		qcom,mdss-dsi-lane-2-state;
		qcom,mdss-dsi-lane-3-state;
		qcom,mdss-dsi-panel-timings-phy-v2 = [
			25 20 09 0a 06 03 04 a0
			25 20 09 0a 06 03 04 a0
			25 20 09 0a 06 03 04 a0
			25 20 09 0a 06 03 04 a0
			25 1e 09 0a 06 03 04 a0];
		qcom,mdss-dsi-t-clk-post = <0xe>;
		qcom,mdss-dsi-t-clk-pre = <0x35>;
		qcom,mdss-dsi-bl-min-level = <1>;
		qcom,mdss-dsi-bl-max-level = <4095>;
		qcom,mdss-dsi-dma-trigger = "trigger_sw";
		qcom,mdss-dsi-lp11-init;
		qcom,mdss-dsi-mdp-trigger = "none";
		qcom,mdss-dsi-bl-pmic-control-type = "bl_ctrl_wled";
		qcom,mdss-dsi-reset-sequence = <0 15 >, <1 15>, <0 15>, <1 120 >;
		qcom,panel-supply-entries = <&nubia_dsi_panel_pwr_supply>;
	};
};
