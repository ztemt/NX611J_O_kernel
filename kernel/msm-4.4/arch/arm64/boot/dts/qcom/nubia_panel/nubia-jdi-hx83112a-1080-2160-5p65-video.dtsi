/* Copyright (c) 2013, The Linux Foundation. All rights reserved.
 *
 * This program is free software; you can redistribute it and/or modify
 * it under the terms of the GNU General Public License version 2 and
 * only version 2 as published by the Free Software Foundation.
 *
 * This program is distributed in the hope that it will be useful,
 * but WITHOUT ANY WARRANTY; without even the implied warranty of
 * MERCHANTABILITY or FITNESS FOR A PARTICULAR PURPOSE.  See the
 * GNU General Public License for more details.
 */

/*---------------------------------------------------------------------------
 * This file is autogenerated file using gcdb parser. Please do not edit it.
 * Update input XML file to add a new entry or update variable in this file
 * VERSION = "1.0"
 *---------------------------------------------------------------------------*/
&mdss_mdp {
	dsi_jdi_hx83112a_1080_2160_5p65_video: qcom,mdss_dsi_jdi_hx83112a_1080_2160_5p65_video {
		qcom,mdss-dsi-panel-name = "jdi hx83112a 1080 2160 5p65 video dsi panel";
		qcom,mdss-dsi-panel-controller = <&mdss_dsi0>;
		qcom,mdss-dsi-panel-type = "dsi_video_mode";
		qcom,mdss-dsi-panel-destination = "display_1";
		qcom,mdss-dsi-panel-framerate = <60>;
		qcom,mdss-dsi-virtual-channel-id = <0>;
		qcom,mdss-dsi-stream = <0>;
		qcom,mdss-dsi-panel-width = <1080>;
		qcom,mdss-dsi-panel-height = <2160>;
		qcom,mdss-dsi-h-front-porch = <32>;
		qcom,mdss-dsi-h-back-porch = <16>;
		qcom,mdss-dsi-h-pulse-width = <2>;
		qcom,mdss-dsi-h-sync-skew = <0>;
		qcom,mdss-dsi-v-back-porch = <2>;
		qcom,mdss-dsi-v-front-porch = <32>;
		qcom,mdss-dsi-v-pulse-width = <2>;
		qcom,mdss-dsi-h-left-border = <0>;
		qcom,mdss-dsi-h-right-border = <0>;
		qcom,mdss-dsi-v-top-border = <0>;
		qcom,mdss-dsi-v-bottom-border = <0>;
		qcom,mdss-dsi-bpp = <24>;
		qcom,mdss-dsi-color-order = "rgb_swap_rgb";
		qcom,mdss-dsi-underflow-color = <0xff>;
		qcom,mdss-dsi-border-color = <0>;
		qcom,mdss-dsi-on-command = [
			29 01 00 00 00 00 04 b9 83 11 2a
			29 01 00 00 00 00 09 b1 08 27 27 83 83 4c 4e cc
			29 01 00 00 00 00 02 bd 01
			29 01 00 00 00 00 08 b1 64 01 09 20 50 00 00
			29 01 00 00 00 00 02 bd 00
			29 01 00 00 00 00 13 b2 00 02 00 80 70 00 02 1e fe 11 11 00 15 a3 87 00 0f d5
			29 01 00 00 00 00 02 bd 02
			29 01 00 00 00 00 02 b2 35
			29 01 00 00 00 00 02 bd 00
			29 01 00 00 00 00 03 d2 2c 2c
			29 01 00 00 00 00 1c b4 02 60 b0 70 b0 70 37 cb 01 01 0a c7 00 ff 00 ff 06 01 03 04 00 39 03 08 09 00 83
			29 01 00 00 00 00 02 bd 02
			29 01 00 00 00 00 0a b4 00 92 12 11 88 12 12 00 53
			29 01 00 00 00 00 02 bd 00
			29 01 00 00 00 00 04 b6 7f 7f e3
			29 01 00 00 00 00 02 c1 01
			29 01 00 00 00 00 1a e3 00 aa aa aa aa aa aa aa aa 55 55 55 55 55 55 55 55 aa aa aa aa aa aa aa aa
			29 01 00 00 00 00 02 bd 01
			29 01 00 00 00 00 3a c1 ff ed e3 dc d6 d1 cc c5 c2 bf bc b9 b7 b5 b2 b0 ae ad ab a7 a4 a1 9d 9a 97 94 91 8e 8a 87 83 7f 7a 75 6f 69 61 58 4b 3a 2d 25 1a 0b 00 39 5d 07 4f c2 4f f8 80 5d 8d 99 00
			29 01 00 00 00 00 3a e3 ff ed e3 dc d6 d1 cc c5 c2 bf bc b9 b7 b5 b2 b0 ae ad ab a7 a4 a1 9d 9a 97 94 91 8e 8a 87 83 7f 7a 75 6f 69 61 58 4b 3a 2d 25 1a 0b 00 39 5d 07 4f c2 4f f8 80 5d 8d 99 00
			29 01 00 00 00 00 02 bd 02
			29 01 00 00 00 00 3a c1 ff ed e3 dc d6 d1 cc c5 c2 bf bc b9 b7 b5 b2 b0 ae ad ab a7 a4 a1 9d 9a 97 94 91 8e 8a 87 83 7f 7a 75 6f 69 61 58 4b 3a 2d 25 1a 0b 00 39 5d 07 4f c2 4f f8 80 5d 8d 99 00
			29 01 00 00 00 00 3a e3 ff ed e3 dc d6 d1 cc c5 c2 bf bc b9 b7 b5 b2 b0 ae ad ab a7 a4 a1 9d 9a 97 94 91 8e 8a 87 83 7f 7a 75 6f 69 61 58 4b 3a 2d 25 1a 0b 00 39 5d 07 4f c2 4f f8 80 5d 8d 99 00
			29 01 00 00 00 00 02 bd 03
			29 01 00 00 00 00 3a c1 ff ed e3 dc d6 d1 cc c5 c2 bf bc b9 b7 b5 b2 b0 ae ad ab a7 a4 a1 9d 9a 97 94 91 8e 8a 87 83 7f 7a 75 6f 69 61 58 4b 3a 2d 25 1a 0b 00 39 5d 07 4f c2 4f f8 80 5d 8d 99 00
			29 01 00 00 00 00 3a e3 ff ed e3 dc d6 d1 cc c5 c2 bf bc b9 b7 b5 b2 b0 ae ad ab a7 a4 a1 9d 9a 97 94 91 8e 8a 87 83 7f 7a 75 6f 69 61 58 4b 3a 2d 25 1a 0b 00 39 5d 07 4f c2 4f f8 80 5d 8d 99 00
			29 01 00 00 00 00 02 bd 00
			29 01 00 00 00 00 03 c0 23 23
			29 01 00 00 00 00 02 cc 08
			29 01 00 00 00 00 2b d3 40 00 00 00 00 01 01 04 00 01 23 33 34 03 03 05 05 32 10 03 00 03 32 10 07 00 07 32 10 01 00 01 00 00 00 00 00 00 00 04 08 75
			29 01 00 00 00 00 02 bd 01
			29 01 00 00 00 00 09 d3 00 00 19 00 00 4a 00 a1
			29 01 00 00 00 00 02 bd 00
			29 01 00 00 00 00 29 d5 18 18 19 18 18 20 18 18 18 10 10 18 18 00 00 18 18 01 01 18 18 18 18 18 18 18 18 18 2f 2f 30 30 31 31 35 35 36 36 37 37
			29 01 00 00 00 00 29 d6 18 18 19 18 18 20 19 18 18 10 10 18 18 01 01 18 18 00 00 18 18 18 18 18 18 18 18 18 2f 2f 30 30 31 31 35 35 36 36 37 37
			29 01 00 00 00 00 19 d8 aa aa aa af ea aa aa aa aa af ea aa aa aa ab af ea aa aa aa ae af ea aa
			29 01 00 00 00 00 02 bd 01
			29 01 00 00 00 00 19 d8 aa aa ab af ea aa aa aa ae af ea aa aa aa aa af ea aa aa aa aa af ea aa
			29 01 00 00 00 00 02 bd 02
			29 01 00 00 00 00 0d d8 aa aa aa af ea aa aa aa aa af ea aa
			29 01 00 00 00 00 02 bd 03
			29 01 00 00 00 00 19 d8 ba aa aa aa bf aa aa aa aa aa bf aa aa aa aa af ea aa aa aa aa af ea aa
			29 01 00 00 00 00 02 bd 00
			29 01 00 00 00 00 19 e7 0e 0e 1e 6e 1e 6e 30 32 02 02 00 00 02 02 02 05 14 14 32 b9 23 b9 08 03
			29 01 00 00 00 00 02 bd 01
			29 01 00 00 00 00 0b e7 02 00 90 01 9c 0d 93 0e 03 03
			29 01 00 00 00 00 02 bd 02
			29 01 00 00 00 00 1e e7 00 00 08 00 01 00 00 00 00 00 00 00 00 00 00 00 00 00 00 00 00 00 8c 00 00 00 00 22 20
			29 01 00 00 00 00 02 bd 00
			29 01 00 00 00 00 05 bf 0f 00 00 83
			29 01 00 00 00 00 07 c7 70 00 04 e0 33 00
			29 01 00 00 00 00 07 cb 11 10 91 fc 00 02
			29 01 00 00 00 00 02 bd 01
			29 01 00 00 00 00 03 cb 25 11
			29 01 00 00 00 00 02 bd 00
			29 01 00 00 00 00 02 cd 01
			29 01 00 00 00 00 14 ba 73 03 64 33 31 00 00 01 10 00 00 10 08 3d 02 77 04 00 1e
			15 01 00 00 00 00 02 e4 2d

			05 01 00 00 78 00 01 11
			05 01 00 00 32 00 01 29
];
		qcom,mdss-dsi-off-command = [
			//set display off
			05 01 00 00 20 00 01 28
			//enter sleep mode
			05 01 00 00 02 00 01 10
		];
		qcom,mdss-dsi-on-command-state = "dsi_lp_mode";
		qcom,mdss-dsi-off-command-state = "dsi_hs_mode";
		qcom,mdss-dsi-h-sync-pulse = <0>;
		qcom,mdss-dsi-traffic-mode = "burst_mode";
		qcom,mdss-dsi-lane-map = "lane_map_0123";
		qcom,mdss-dsi-bllp-eof-power-mode;
		qcom,mdss-dsi-bllp-power-mode;
		qcom,mdss-dsi-lane-0-state;
		qcom,mdss-dsi-lane-1-state;
		qcom,mdss-dsi-lane-2-state;
		qcom,mdss-dsi-lane-3-state;
		qcom,mdss-dsi-panel-timings-phy-v2 = [
			24 1f 08 09 05 03 04 a0
			24 1f 08 09 05 03 04 a0
			24 1f 08 09 05 03 04 a0
			24 1f 08 09 05 03 04 a0
			24 1b 08 09 05 03 04 a0];
		qcom,mdss-dsi-t-clk-post = <0x77>;
		qcom,mdss-dsi-t-clk-pre = <0x09>;
		qcom,mdss-dsi-bl-min-level = <1>;
		qcom,mdss-dsi-bl-max-level = <4095>;
		qcom,mdss-dsi-lp11-init;
		qcom,mdss-dsi-dma-trigger = "trigger_sw";
		qcom,mdss-dsi-mdp-trigger = "none";
		qcom,mdss-dsi-bl-pmic-control-type = "bl_ctrl_wled";
		qcom,mdss-dsi-reset-sequence = <0 5>, <1 60>;
		qcom,panel-supply-entries = <&nubia_dsi_panel_pwr_supply>;
		};};
