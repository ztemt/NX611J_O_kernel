/* Copyright (c) 2013, The Linux Foundation. All rights reserved.
 *
 * This program is free software; you can redistribute it and/or modify
 * it under the terms of the GNU General Public License version 2 and
 * only version 2 as published by the Free Software Foundation.
 *
 * This program is distributed in the hope that it will be useful,
 * but WITHOUT ANY WARRANTY; without even the implied warranty of
 * MERCHANTABILITY or FITNESS FOR A PARTICULAR PURPOSE.  See the
 * GNU General Public License for more details.
 */

/*---------------------------------------------------------------------------
 * This file is autogenerated file using gcdb parser. Please do not edit it.
 * Update input XML file to add a new entry or update variable in this file
 * VERSION = "1.0"
 *---------------------------------------------------------------------------*/
&mdss_mdp {
	dsi_lead_hx83112a_1080_2160_5p65_video: qcom,mdss_dsi_lead_hx83112a_1080_2160_5p65_video {
		qcom,mdss-dsi-panel-name = "lead hx83112a 1080 2160 5p65 video dsi panel";
		qcom,mdss-dsi-panel-controller = <&mdss_dsi0>;
		qcom,mdss-dsi-panel-type = "dsi_video_mode";
		qcom,mdss-dsi-panel-destination = "display_1";
		qcom,mdss-pan-physical-width-dimension = <64>;
		qcom,mdss-pan-physical-height-dimension = <128>;
		qcom,mdss-dsi-panel-framerate = <60>;
		qcom,mdss-dsi-virtual-channel-id = <0>;
		qcom,mdss-dsi-stream = <0>;
		qcom,mdss-dsi-panel-width = <1080>;
		qcom,mdss-dsi-panel-height = <2160>;
		qcom,mdss-dsi-h-front-porch = <40>;
		qcom,mdss-dsi-h-back-porch = <8>;
		qcom,mdss-dsi-h-pulse-width = <8>;
		qcom,mdss-dsi-h-sync-skew = <0>;
		qcom,mdss-dsi-v-back-porch = <8>;
		qcom,mdss-dsi-v-front-porch = <40>;
		qcom,mdss-dsi-v-pulse-width = <8>;
		qcom,mdss-dsi-h-left-border = <0>;
		qcom,mdss-dsi-h-right-border = <0>;
		qcom,mdss-dsi-v-top-border = <0>;
		qcom,mdss-dsi-v-bottom-border = <0>;
		qcom,mdss-dsi-bpp = <24>;
		qcom,mdss-dsi-color-order = "rgb_swap_rgb";
		qcom,mdss-dsi-underflow-color = <0xff>;
		qcom,mdss-dsi-border-color = <0>;
		qcom,nubia-vddio-on-post-delay = <5000>;
		qcom,nubia-vddio-off-pre-delay = <5000>;
		qcom,nubia-vddio-gpio-num = <21>;
		qcom,nubia-tp-reset-gpio = <66>;
		qcom,mdss-dsi-on-command = [
/*
			39 01 00 00 00 00 04 B9 83 11 2A 
			39 01 00 00 00 00 09 B1 08 29 29 00 00 4F 54 33
			39 01 00 00 00 00 11 B2 00 02 00 80 70 00 08 26 FC 01 00 03 15 A3 87 09 
			39 01 00 00 00 00 02 BD 00 
			39 01 00 00 00 00 03 D2 2C 2C 
			39 01 00 00 00 00 1C B4 01 CE 01 CE 01 CE 0A CE 0A CE 0A CE 00 FF 00 FF 00 00 22 23 00 28 0A 13 14 00 8A
			39 01 00 00 00 00 02 BD 02 
			39 01 00 00 00 00 0A B4 00 92 12 22 88 12 12 00 53
			39 01 00 00 00 00 02 BD 00 
			39 01 00 00 00 00 04 B6 82 82 E3 
			39 01 00 00 00 00 02 CC 08
			39 01 00 00 00 00 2B D3 40 00 00 00 00 01 01 0A 0A 07 07 00 08 09 09 09 09 32 10 09 00 09 32 21 0A 00 0A 32 10 08 00 00 00 00 00 00 00 00 00 0B 08 82 
			39 01 00 00 00 00 02 BD 01 
			39 01 00 00 00 00 09 D3 00 00 19 00 00 0A 00 81 
			39 01 00 00 00 00 02 BD 00 
			39 01 00 00 00 00 31 D5 18 18 18 18 18 18 18 18 31 31 30 30 2F 2F 31 31 30 30 2F 2F C0 18 40 40 01 00 07 06 05 04 03 02 21 20 18 18 19 19 18 18 03 03 18 18 18 18 18 18
			39 01 00 00 00 00 31 D6 18 18 18 18 18 18 18 18 31 31 30 30 2F 2F 31 31 30 30 2F 2F C0 18 40 40 02 03 04 05 06 07 00 01 20 21 18 18 18 18 19 19 20 20 18 18 18 18 18 18
			39 01 00 00 00 00 19 D8 00 00 00 00 00 00 00 00 00 00 00 00 00 00 00 00 00 00 00 00 00 00 00 00 
			39 01 00 00 00 00 02 BD 01 
			39 01 00 00 00 00 19 D8 AA AA AA AA AA AA AA AA AA AA AA AA AA AA AA AA AA AA AA AA AA AA AA AA 
			39 01 00 00 00 00 02 BD 02 
			39 01 00 00 00 00 0D D8 AF FF FA AA BA AA AA FF FA AA BA AA
			39 01 00 00 00 00 02 BD 03 
			39 01 00 00 00 00 19 D8 AA AA AA AA AA AA AA AA AA AA AA AA AA AA AA AA AA AA AA AA AA AA AA AA 
			39 01 00 00 00 00 02 BD 00 
			39 01 00 00 00 00 18 E7 0E 0E 1E 6A 1D 6A 00 32 02 02 00 00 02 02 02 05 14 14 32 B9 23 B9 08 
			39 01 00 00 00 00 02 BD 01 
			39 01 00 00 00 00 0A E7 02 00 98 01 9A 0D A8 0E 01 
			39 01 00 00 00 00 02 BD 02 
			39 01 00 00 00 00 1E E7 00 00 08 00 01 00 00 00 00 00 00 00 00 00 00 00 00 00 00 00 00 00 04 00 00 00 00 02 00 
			39 01 00 00 00 00 02 BD 00 
			39 01 00 00 00 00 02 C1 01 
			39 01 00 00 00 00 02 BD 01
			39 01 00 00 00 00 3A C1 FF F7 F0 E9 E2 DB D4 C6 BF B8 B1 AB A5 9F 99 94 8E 8A 85 7C 74 6C 65 5F 58 52 4B 47 42 3C 37 31 2C 27 22 1C 18 12 0D 08 05 04 02 01 00 27 B9 BE 54 C6 B8 9C 37 43 3D E5 00
			39 01 00 00 00 00 02 BD 02 
			39 01 00 00 00 00 3A C1 FF F7 F0 E9 E2 DB D4 C6 BF B8 B1 AB A5 9F 99 94 8E 8A 85 7C 74 6C 65 5F 58 52 4B 47 42 3C 37 31 2C 27 22 1C 18 12 0D 08 05 04 02 01 00 27 B9 BE 54 C6 B8 9C 37 43 3D E5 00
			39 01 00 00 00 00 02 BD 03 
			39 01 00 00 00 00 3A C1 FF F7 F0 E9 E2 DB D4 C6 BF B8 B1 AB A5 9F 99 94 8E 8A 85 7C 74 6C 65 5F 58 52 4B 47 42 3C 37 31 2C 27 22 1C 18 12 0D 08 05 04 02 01 00 27 B9 BE 54 C6 B8 9C 37 43 3D E5 00
			39 01 00 00 00 00 02 BD 00 
			39 01 00 00 00 00 02 E9 C3
			39 01 00 00 00 00 03 CB 92 01
			39 01 00 00 00 00 02 E9 3F
			39 01 00 00 00 00 07 C7 70 00 04 E0 33 00 
			39 01 00 00 00 00 03 51 0f ff
			39 01 00 00 00 00 03 5e 00 00
			15 01 00 00 00 00 02 55 00
			15 01 00 00 00 00 02 53 24
			15 01 00 00 00 00 02 35 00
			05 01 00 00 78 00 01 11
			05 01 00 00 32 00 01 29
*/
			39 01 00 00 00 00 04 b9 83 11 2a
			39 01 00 00 00 00 03 51 0f ff
			39 01 00 00 00 00 03 5e 00 00
			15 01 00 00 00 00 02 55 00
			15 01 00 00 00 00 02 53 24
			15 01 00 00 00 00 02 35 00
			05 01 00 00 00 00 02 11 29
			05 01 00 00 34 00 02 29 00
		];
		qcom,mdss-dsi-off-command = [
			//set display off
			05 01 00 00 20 00 01 28
			//enter sleep mode
			05 01 00 00 02 00 01 10
		];
		nubia,mdss-dsi-panel-backlight-curve = <
		0 34 34 34 35 35 36 36
		37 37 38 38 39 39 40 40
		41 41 42 43 45 47 49 51
		53 55 57 59 61 63 66 69
		72 75 78 82 86 90 94 98
		101 104 107 110 113 117 121 125
		129 133 137 142 147 152 157 162
		167 172 177 182 187 193 199 205
		211 217 224 231 238 245 252 259
		266 273 280 287 294 301 308 316
		324 332 340 348 356 364 373 382
		391 400 409 418 427 436 445 455
		465 475 485 495 505 516 527 538
		549 560 571 582 593 604 615 626
		638 650 662 675 688 701 714 727
		740 753 766 779 792 805 818 831
		846 861 876 891 906 921 936 951
		966 981 996 1011 1027 1043 1059 1075
		1091 1109 1126 1143 1160 1177 1194 1210
		1229 1248 1267 1286 1305 1324 1343 1362
		1381 1400 1420 1440 1460 1480 1500 1520
		1541 1562 1583 1604 1625 1646 1668 1690
		1712 1734 1756 1778 1801 1824 1847 1870
		1894 1918 1942 1966 1990 2015 2040 2065
		2090 2115 2140 2166 2192 2218 2244 2270
		2297 2324 2351 2378 2405 2432 2459 2487
		2516 2545 2574 2603 2632 2661 2690 2720
		2750 2780 2810 2840 2871 2902 2933 2964
		2995 3026 3058 3090 3122 3154 3186 3218
		3252 3286 3320 3354 3388 3422 3456 3489
		3526 3563 3600 3637 3674 3711 3748 3786
		3829 3862 3900 3938 3976 4014 4052 4095
		>;

                nubia,mdss-dsi-cabc-command-off = [
                        39 01 00 00 00 00 02 55 00
                ];
                nubia,mdss-dsi-cabc-command-level1 = [
                        39 01 00 00 00 00 02 55 01
                ];
                nubia,mdss-dsi-cabc-command-level2 = [
                        39 01 00 00 00 00 02 55 02
                ];
                nubia,mdss-dsi-cabc-command-level3 = [
                        39 01 00 00 00 00 02 55 03
                ];
                nubia,mdss-dsi-cabc-command-state = "dsi_lp_mode";

		qcom,mdss-dsi-on-command-state = "dsi_lp_mode";
		qcom,mdss-dsi-off-command-state = "dsi_hs_mode";
		qcom,mdss-dsi-h-sync-pulse = <0>;
		qcom,mdss-dsi-traffic-mode = "burst_mode";
		qcom,mdss-dsi-lane-map = "lane_map_0123";
		qcom,mdss-dsi-bllp-eof-power-mode;
		qcom,mdss-dsi-bllp-power-mode;
		qcom,mdss-dsi-lane-0-state;
		qcom,mdss-dsi-lane-1-state;
		qcom,mdss-dsi-lane-2-state;
		qcom,mdss-dsi-lane-3-state;
		qcom,mdss-dsi-panel-timings-phy-v2 = [
			24 1f 08 09 05 03 04 a0
			24 1f 08 09 05 03 04 a0
			24 1f 08 09 05 03 04 a0
			24 1f 08 09 05 03 04 a0
			24 1b 08 09 05 03 04 a0];
		qcom,mdss-dsi-t-clk-post = <0x0d>;
		qcom,mdss-dsi-t-clk-pre = <0x1c>;
		qcom,mdss-dsi-bl-min-level = <1>;
		qcom,mdss-dsi-bl-max-level = <4095>;
		qcom,mdss-brightness-max-level = <4095>;
		qcom,mdss-brightness-min-level = <1>;
		qcom,mdss-dsi-lp11-init;
		qcom,mdss-dsi-dma-trigger = "trigger_sw";
		qcom,mdss-dsi-mdp-trigger = "none";
		qcom,mdss-dsi-bl-pmic-control-type = "bl_ctrl_wled";
		qcom,mdss-dsi-reset-sequence = <0 5>, <1 60>;
		qcom,panel-supply-entries = <&nubia_dsi_panel_pwr_supply>;
		};};
