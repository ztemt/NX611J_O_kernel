
qcom,atl_3450mah {
	qcom, = <24>;
	/* #3249359_ZTE_NX611_3450mAh_averaged_MasterSlave_Dec5th2017*/
	qcom,max-voltage-uv = <4400000>;
	qcom,fg-cc-cv-threshold-mv = <4385>;
	qcom,nom-batt-capacity-mah = <3450>;
	qcom,batt-id-kohm = <15>;
	qcom,battery-beta = <4050>;
	qcom,battery-type = "atl_3450mah";
	qcom,checksum = <0x63F2>;
	qcom,gui-version = "PM660GUI - 0.0.0.45";
	qcom,fg-profile-data = [
		 E1 1E D9 FC
		 A1 03 FB FD
		 D2 1C 2C 02
		 45 0D 2C 0B
		 07 18 55 23
		 24 45 60 53
		 69 00 00 00
		 12 00 00 00
		 00 00 74 CD
		 95 CD 22 D2
		 23 00 08 00
		 D8 DB 07 E4
		 C7 06 62 F2
		 27 01 58 12
		 13 06 98 32
		 18 06 09 20
		 27 00 14 00
		 71 1F F9 05
		 1E 0A B5 06
		 C2 1C 12 03
		 D4 15 69 12
		 7D 18 FD 23
		 BC 4D 90 5B
		 65 00 00 00
		 0D 00 00 00
		 00 00 BB D5
		 31 CA 89 C2
		 1E 00 00 00
		 04 EB 07 E4
		 5F F4 69 00
		 EB DD 66 03
		 BF 02 E8 1A
		 B9 33 CC FF
		 07 10 00 00
		 8D 0D 66 46
		 1E 00 40 00
		 6C 01 0A FA
		 FF 00 00 00
		 00 00 00 00
		 00 00 00 00
		 00 00 00 00
		 00 00 00 00
		 00 00 00 00
		 00 00 00 00
		 00 00 00 00
		 00 00 00 00
		 00 00 00 00
		 00 00 00 00
		 00 00 00 00
		 00 00 00 00
		 00 00 00 00
		 00 00 00 00
		 00 00 00 00
		 00 00 00 00
		 00 00 00 00
		 00 00 00 00
	];
};
