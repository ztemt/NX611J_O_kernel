## kernel/msm-4.4/drivers/nubia/Kconfig
```kconfig
#
# Nubia drivers configuration
#

#menuconfig NUBIA_DRIVERS
menu "nubia drivers"

config NUBIA_DRIVERS
	bool "NUBIA DRIVERS"
	default n
	help
	  Say Y here if you want to enable NUBIA DRIVERS
	  If unsure, say N.

comment "Nubia Device Drivers"

if NUBIA_DRIVERS
# Add nubia drivers configuration here

config NUBIA_TOUCHSCREENS
	bool "NUBIA_TOUCHSCREENS"
	depends on NUBIA_DRIVERS
	default n
	help
	  Say Y here if you want to enable NUBIA_TOUCHSCREENS
	  If unsure, say N.

if NUBIA_TOUCHSCREENS
source "drivers/nubia/touch/Kconfig"
endif

config NUBIA_NFC
	bool "NUBIA_NFC"
	depends on NUBIA_DRIVERS
	default n
	help
	  Say Y here if you want enable NUBIA_NFC
	  If unsure, say N.

if NUBIA_NFC
source "drivers/nubia/nfc/Kconfig"
endif

config NUBIA_DISPLAY
	bool "NUBIA_DISPLAY"
	depends on NUBIA_DRIVERS
	default n
	help
	  Say Y here if you want to enable NUBIA_DISPLAY
	  If unsure, say N.

if NUBIA_DISPLAY
source "drivers/nubia/display/Kconfig"
endif

config NUBIA_SENSORS
	bool "NUBIA_SENSORS"
	depends on NUBIA_DRIVERS
	default n
	help
	  Say Y here if you don't want to enable NUBIA_SENSORS
	  If unsure, say N.

if NUBIA_SENSORS
source drivers/nubia/sensors/Kconfig
endif

endif

endmenu
```

## kernel/msm-4.4/drivers/nubia/display/Kconfig
```kconfig
#
# nubia disp lcd extern interface module configuration
#
config NUBIA_DISP_LCD_FEATURE
       bool "nubia lcd feature"
       default n
       ---help---
       Enable nubia lcd feature.

config NUBIA_DISP_LCD_VDDIO_GPIO
       bool "nubia lcd vddio control by gpio"
       default n
       ---help---
       Enable nubia lcd vddio control by gpio.

config NUBIA_DISP_KEEP_POWER_ON
       bool "nubia lcd keep power on"
       default n
       ---help---
       Enable nubia lcd keep power on.

config NUBIA_DISP_JDI_HX83112A
       bool "nubia lcd is jdi hx83112a"
       default n
       ---help---
       Enable nubia is jdi hx83112a.

config NUBIA_DISP_LEAD_HX83112A
       bool "nubia lcd is lead hx83112a"
       default n
       ---help---
       Enable nubia is lead hx83112a.

config NUBIA_DISP_LCD_PANEL_ID
       bool "nubia lcd panel id"
       default n
       ---help---
       Enable nubia lcd panel id.

config NUBIA_DISP_LCD_PREFERENCE
       bool "nubia lcd preference"
       default n
       ---help---
       Enable nubia lcd preference.

config NUBIA_LCD_BACKLIGHT_CURVE
       bool "nubia lcd bl curve"
       default n
       ---help---
       Enable nubia lcd bl curve.
```

## kernel/msm-4.4/drivers/nubia/fingerprint/Kconfig
```kconfig
################################################# FINGER_PRINTER START
config  NUBIA_SENSORS_FP
	tristate "NUBIA FP DEVICE"
	default n

if NUBIA_SENSORS_FP

################################################# FINGER_PRINTER_GF5228M START
source drivers/nubia/fingerprint/gf5228/Kconfig
choice
        prompt "choose the GF5228M device style"
        depends on NUBIA_SENSORS_FP_GF5228
        default NUBIA_SENSORS_FP_GF5228_PLATFORM
        help
           GF5228M need to select the work style

config NUBIA_SENSORS_FP_GF5228_SPI
        bool "GF5228M work as SPI device"
        help
          If you want GF5228M work as SPI device, select it.

config NUBIA_SENSORS_FP_GF5228_PLATFORM
        bool "GF5228M work as PLATFORM device"
        help
          If you want GF5228M work as PLATFORM device, select it.

endchoice
################################################# FINGER_PRINTER_GF5228M END


endif
```

## kernel/msm-4.4/drivers/nubia/fingerprint/sunwave_fp/Kconfig
```kconfig
config NUBIA_SENSORS_FP_SUNWAVE
	tristate "Sunwave Fingerprint"
	depends on NUBIA_SENSORS_FP
	default n
	help
	  If you say Y to this option, support will be included for 
	  the Sunwave's fingerprint sensor. This driver supports 
	  both REE and TEE. If in REE, CONFIG_SPI_SPIDEV must be set 
	  to use the standard 'spidev' driver.
	
	  This driver can also be built as a module. If so, the module
	  will be called 'sunwave_fp'.
```

## kernel/msm-4.4/drivers/nubia/nfc/Kconfig
```kconfig
#
# Near Field Communication (NFC) devices
#

menu "Near Field Communication (NFC) devices"
	depends on NUBIA_NFC
source "drivers/nubia/nfc/samsung/Kconfig"

endmenu
```

## kernel/msm-4.4/drivers/nubia/touch/Kconfig
```kconfig
menu "nubia driver touchscreens"

config NUBIA_TOUCHSCREEN_NT36XXX
        bool "config nubia touchscreens nt36xxx"
        default n
        help
          Say Y here if you have a nubia touchscreen nt36xxx connected
          to your system.
	  If unsure, say N.

if NUBIA_TOUCHSCREEN_NT36XXX
source "drivers/nubia/touch/nt36xxx/Kconfig"
endif

config NUBIA_TOUCHSCREEN_HXCHIPSET
        bool "config nubia touchscreens hxchipset"
        default n
        help
          Say Y here if you have a nubia touchscreen hxchipset connected
          to your system.
	  If unsure, say N.

if NUBIA_TOUCHSCREEN_HXCHIPSET
source "drivers/nubia/touch/hxchipset/Kconfig"
endif

endmenu
```

## kernel/msm-4.4/drivers/nubia/touch/hxchipset/Kconfig
```kconfig
#
# Himax Touchscreen driver configuration
#

config TOUCHSCREEN_HIMAX_I2C
        tristate "HIMAX chipset i2c touchscreen"
		depends on NUBIA_TOUCHSCREEN_HXCHIPSET
		help
		This enables support for HIMAX CHIPSET over I2C based touchscreens.

config TOUCHSCREEN_HIMAX_DEBUG
        tristate "HIMAX debug function"
		depends on TOUCHSCREEN_HIMAX_I2C
		help
		This enables support for HIMAX debug function.

config TOUCHSCREEN_HIMAX_ITO_TEST
	tristate "HIMAX driver test over Dragon Board"
	depends on TOUCHSCREEN_HIMAX_I2C
	help
	  This enables support for HIMAX driver test over Dragon Board.

config HMX_DB
	tristate "HIMAX driver test over Dragon Board"
	depends on TOUCHSCREEN_HIMAX_I2C
	help
	  This enables support for HIMAX driver test over Dragon Board.

config NUBIA_TP_HIMAX_REPAIRED_BUG
	tristate "HIMAX driver repaired bug by NUBIA"
	depends on TOUCHSCREEN_HIMAX_I2C
	help
	  This enables support for HIMAX driver repaired bug by NUBIA.

config NUBIA_TP_HIMAX_ESD_CHECK
        tristate "HIMAX driver add nubia esd check"
        depends on TOUCHSCREEN_HIMAX_I2C
        help
          This enables support for HIMAX driver add nubia esd check by NUBIA.
```
